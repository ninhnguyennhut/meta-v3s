## conf/layer.conf
```bitbake
# We have a conf and classes directory, append to BBPATH
BBPATH .= ":${LAYERDIR}"

# We have a recipes directory, add to BBFILES
BBFILES += "${LAYERDIR}/recipes*/*/*.bb ${LAYERDIR}/recipes*/*/*.bbappend"

BBFILE_COLLECTIONS += "meta-v3s"
BBFILE_PATTERN_meta-v3s := "^${LAYERDIR}/"
BBFILE_PRIORITY_meta-v3s = "6"

LAYERSERIES_COMPAT_meta-v3s = "warrior"
```

## conf/machine/include/sunxi.inc
```bitbake
SOC_FAMILY ??= ""
include conf/machine/include/soc-family.inc

# Sub-architecture support
MACHINE_SOCARCH_SUFFIX ?= ""
MACHINE_SOCARCH_SUFFIX_sun4i = "-sun4i"

PREFERRED_PROVIDER_virtual/xserver = "xserver-xorg"
XSERVER = "xserver-xorg \
           xf86-video-fbturbo \
           xf86-input-evdev \
           xf86-input-mouse \
           xf86-input-keyboard"

UBOOT_LOCALVERSION = "-g${@d.getVar('SRCPV', True).partition('+')[2][0:7]}"

UBOOT_ENTRYPOINT ?= "0x40008000"

SERIAL_CONSOLE ?= "115200 ttyS0"
MACHINE_FEATURES ?= "alsa apm keyboard rtc serial screen usbgadget usbhost vfat"
```

## conf/machine/v3s.conf
```bitbake
#@TYPE: Machine
#@NAME: V3S 
#@DESCRIPTION: Machine configuration for the V3S 

TARGET_ARCH = "arm"
require conf/machine/include/sun8i.inc

PREFERRED_PROVIDER_virtual/kernel = "linux-v3s"
KERNEL_IMAGETYPE = "zImage"

PREFERRED_PROVIDER_virtual/bootloader = "u-boot"
PREFERRED_PROVIDER_u-boot = "u-boot"

UBOOT_ENTRYPOINT  = "0x40008000"
UBOOT_LOADADDRESS = "0x40008000"
UBOOT_MACHINE = "am335x_boneblack_config"

#UBOOT_ENTRYPOINT = "0x80008000"
#UBOOT_LOADADDRESS = "0x80008000"
#UBOOT_MACHINE = "am335x_boneblack_config"
#BOOTENV_SIZE = "0x20000"

EXTRA_IMAGEDEPENDS += "u-boot"

SERIAL_CONSOLE = "115200 ttyS0"

IMAGE_CLASSES += "sdcard_image-sunxi"
IMAGE_FSTYPES += "ext4 tar.gz tar.xz sunxi-sdimg"

MACHINE_ESSENTIAL_EXTRA_RDEPENDS = "kernel-image kernel-devicetree"

MACHINE_FEATURES = "ext2 ext4 tar.xz serial usbhost vfat"
```
